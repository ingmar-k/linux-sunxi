## Documentation/devicetree/bindings/mmc/sunxi-mmc.txt
```
* Allwinner sunxi MMC controller

The highspeed MMC host controller on Allwinner SoCs provides an interface
for MMC, SD and SDIO types of memory cards.

Supported maximum speeds are the ones of the eMMC standard 4.5 as well
as the speed of SD standard 3.0.
Absolute maximum transfer rate is 200MB/s

Required properties:
- the driver should be called as "allwinner,sun5i-a13-mmc"
- base registers are 0x1000 appart, so the base of mmc1
  would be 0x01c0f000+0x1000=0x01c10000 and so on.
- clocks requires the reference at the ahb clock gate
  with the correct index (mmc0 -> 8, mmc1 -> 9, and so on)
  as well as the reference to the correct mod0 clock (e.g. mmc0_clk).
- clock names and order of the labels and references should be according
  to the example at the bottom of this page
- interrupts requires the correct IRQ line
  (mmc0 -> 32, mmc1 -> 33, and so on)
  - for sun4i and sun5i the IRQ vector is a single cell
  - for sun7i the IRQ is formated as a tripple cell
- for cd, bus-width and additional generic mmc parameters
  please refer to mmc.txt within this directory

Examples:
	- Within .dtsi:
	mmc0: mmc@01c0f000 {
	      compatible = "allwinner,sun5i-a13-mmc";
	      reg = <0x01c0f000 0x1000>;
	      clocks = <&ahb_gates 8>, <&mmc0_clk>;
	      clock-names = "ahb", "mod";
	      interrupts = <0 32 4>;
	      bus-width = <4>;
	      cd-inverted;
	      status = "disabled";
	};

	- Within dts:
	mmc0: mmc@01c0f000 {
		pinctrl-names = "default", "default";
		pinctrl-0 = <&mmc0_pins_a>;
		pinctrl-1 = <&mmc0_cd_pin_reference_design>;
		cd-gpios = <&pio 7 1 0>; /* PH1 */
		status = "okay";
	};
```
